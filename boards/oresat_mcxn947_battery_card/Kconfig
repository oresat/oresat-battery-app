## boards/oresat_mcxn947_battery_card/Kconfig
```kconfig
# Copyright 2024-2025 NXP
# SPDX-License-Identifier: Apache-2.0

config BOARD_ORESAT_MCXN947_BATTERY_CARD
	select BOARD_EARLY_INIT_HOOK

config SEQUENCE_SAMPLES
	int "Number of samples to be made on the sequence for each channel."
	default 1

config SEQUENCE_OVERSAMPLING
	int "Number of conversion results to average for each sample."
	default 7

config SEQUENCE_RESOLUTION
	int "Set the resolution of the sequence readings."
	default 12

config SEQUENCE_32BITS_REGISTERS
	bool "ADC data sequences are on 32bits"
	default n
```
