## boards/oresat_mcxn947_battery_card/board.yml
```yaml
board:
  name: oresat_mcxn947_battery_card
  full_name: Oresat MCXN947 Battery Card
  vendor: psas
  socs:
    - name: mcxn947
```

## boards/oresat_stm32_battery_card/Kconfig.defconfig
```kconfig
# STM32 Nucleo-64 development board with STM32F091RC MCU

# Copyright (c) 2017 Bobby Noelte
# SPDX-License-Identifier: Apache-2.0

if BOARD_ORESAT_STM32_BATTERY_CARD

config SPI_STM32_INTERRUPT
	default y
	depends on SPI

endif # BOARD_ORESAT_STM32_BATTERY_CARD
```

## boards/oresat_stm32_battery_card/Kconfig.oresat_stm32_battery_card
```kconfig
# Copyright (c) 2017 Bobby Noelte
# SPDX-License-Identifier: Apache-2.0

config BOARD_ORESAT_STM32_BATTERY_CARD
	select SOC_STM32F091XC
	select I2C_STM32_BUS_RECOVERY
```

## boards/oresat_stm32_battery_card/board.yml
```yaml
board:
  name: oresat_stm32_battery_card
  full_name: Oresat STM32F091 Battery Card
  vendor: psas
  socs:
    - name: stm32f091xc
```

## boards/oresat_stm32_battery_card/dts/bindings/battery-packs.yaml
```yaml
# Oresat battery pack

description: Oresat battery packs device

compatible: "battery-packs"

properties:
  "#gpio-cells":
    type: int
    required: true
    description: Number of items to expect in a GPIO specifier

  alert-gpios:
    type: phandle-array
    required: true
    description: |
      Alert inputs. Number of entries for this and the other gpios
      should match number of packs.

  charge-stat-oc-gpios:
    type: phandle-array
    description: |
      Charge status inputs

  discharge-stat-oc-gpios:
    type: phandle-array
    description: |
      Disharge status inputs

  charge-disable-gpios:
    type: phandle-array
    description: |
      Charge disable outputs

  discharge-disable-gpios:
    type: phandle-array
    description: |
      Discharge disable outputs

  heater-gpios:
    type: phandle-array
    description: |
      Battery pack heater enable outputs

  moarpwr-gpios:
    type: phandle-array
    description: |
      Single output to request more power allowance so we can
      enable heaters.

include: [base.yaml]
```
